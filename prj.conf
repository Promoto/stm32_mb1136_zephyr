## CMakeLists.txt
```
cmake_minimum_required(VERSION 3.20.0)

# 尋找 Zephyr 套件，這依賴於環境變數 ZEPHYR_BASE
find_package(Zephyr REQUIRED HINTS $ENV{ZEPHYR_BASE})

project(stm32_mb1136_zephyr)

target_sources(app PRIVATE 
    src/main.c
    test/gpio_test.c
    test/uart_test.c
)

# 加入這行，讓編譯器認得 test 資料夾裡的 .h 檔
target_include_directories(app PRIVATE 
    src
    test
)
```

## prj.conf
```kconfig
# 開啟序列埠功能
CONFIG_SERIAL=y
# 開啟 Console 功能，並指定走 UART
CONFIG_CONSOLE=y
CONFIG_UART_CONSOLE=y
# 開啟 printk
CONFIG_PRINTK=y


CONFIG_GPIO=y
```

## app.overlay
```dts
/* app.overlay */
&usart3 {
    status = "okay";
    current-speed = <115200>;
    /* 如果有腳位變更，需補上 pinctrl 設定 */
};
```

## src/main.c
```c
/*
 * Copyright (c) 2012-2014 Wind River Systems, Inc.
 *
 * SPDX-License-Identifier: Apache-2.0
 */

#include <stdio.h>
#include <zephyr/kernel.h> // 確保有引入 kernel.h 來使用 k_msleep

#include "gpio_test.h"
#include "uart_test.h"

int main(void)
{
    static uint32_t sys_cnt = 0;

	// 強制開啟 STM32 在 Sleep, Stop, Standby 模式下的除錯時脈
    *(volatile uint32_t *)0xE0042004 |= 0x07;

	printf("Hello World! %s\n", CONFIG_BOARD_TARGET);
	
    custom_gpio_init();

    custom_uart_init();

	while(1)
	{
        custom_gpio_toggle_handle();

        custom_uart_test();

		printf("JACK my_custom_app = %d\r\n", sys_cnt++);

		k_msleep(1000);
	}

	return 0;
}
```
